#ifndef LEDS_H
#define LEDS_H
// Generated by Copilot
// #define FASTLED_ALLOW_INTERRUPTS 1
// #define FASTLED_INTERRUPT_RETRY_COUNT 2 // Gibt FastLED mehr Versuche bei Kollisionen
#include <FastLED.h>

// Hardware-Konfiguration
#define LED_PIN 4    // Passe deinen Daten-Pin hier an
#define NUM_LEDS 150 // 5 Flügel * 30 LEDs
#define NUM_WINGS 5
#define LEDS_PER_WING 30

// Globale LED-Datenbank (CRGB Array)
CRGB leds[NUM_LEDS];

// Globale Steuer-Variablen (von außen in main.cpp veränderbar)
uint8_t currentEffect = 0;      // 0 bis ledEffectCount()-1
uint8_t globalBrightness = 150; // 0 bis 255
uint8_t effectSpeed = 128;      // 1 (langsam) bis 255 (sehr schnell)
int strobePauseMs = 80;         // Für Effekt 0 (Stroboskop)
uint8_t solidRed = 255;         // 0 bis 255
uint8_t solidGreen = 255;       // 0 bis 255
uint8_t solidBlue = 255;        // 0 bis 255
bool gEffectRequestsShow = true;
bool gForceEffectDraw = true;
uint8_t gLastRenderedEffect = 255;
uint32_t gLastStrobePeriodUs = 0;

// Interne Hilfsvariablen für Animationen
uint8_t gHue = 0;

// Hilfsfunktion: Setzt Farbe für eine LED auf einem bestimmten Flügel
void setWingPixel(uint8_t wing, uint8_t ledIndex, CRGB color)
{
  if (wing < NUM_WINGS && ledIndex < LEDS_PER_WING)
  {
    leds[(wing * LEDS_PER_WING) + ledIndex] = color;
  }
}

// ==========================================
// DIE 11 EFFEKTE (MODULAR)
// ==========================================

// // 0. STROBOSKOP (Zum Finden der RPM)
// void eff_Stroboskop()
// {
//   static bool shownOn = false;
//   static uint32_t lastFlashStartUs = 0;

//   const uint32_t nowUs = micros();
//   const uint32_t onTimeUs = 1000UL;
//   const uint32_t offTimeUs = static_cast<uint32_t>(strobePauseMs) * 1000UL;
//   const uint32_t periodUs = onTimeUs + offTimeUs;
//   const bool shouldBeOn = periodUs > 0 ? ((nowUs % periodUs) < onTimeUs) : false;

//   if (gForceEffectDraw)
//   {
//     shownOn = false;
//     FastLED.clear();
//     FastLED.show();
//     lastFlashStartUs = 0;
//   }

//   if (shouldBeOn == shownOn)
//   {
//     return;
//   }

//   if (shouldBeOn)
//   {
//     for (uint8_t w = 0; w < NUM_WINGS; ++w)
//     {
//       for (uint8_t i = 0; i < LEDS_PER_WING; i += 3)
//       {
//         setWingPixel(w, i, CRGB::White);
//       }
//     }
//     FastLED.show();

//     if (lastFlashStartUs != 0)
//     {
//       gLastStrobePeriodUs = nowUs - lastFlashStartUs;
//     }
//     lastFlashStartUs = nowUs;
//     shownOn = true;
//     return;
//   }

//   FastLED.clear();
//   FastLED.show();
//   shownOn = false;
// }

void eff_Stroboskop()
{
  static bool shownOn = false;
  static uint32_t lastStateChangeUs = 0;
  static uint32_t lastFlashStartUs = 0;

  const uint32_t nowUs = micros();
  const uint32_t onTimeUs = 1000UL;
  const uint32_t offTimeUs = static_cast<uint32_t>(strobePauseMs) * 1000UL;

  // 1. Reset-Logik
  if (gForceEffectDraw)
  {
    shownOn = false;
    FastLED.clear();
    FastLED.show();
    lastFlashStartUs = 0;
    lastStateChangeUs = nowUs;
    gForceEffectDraw = false; // Wichtig: Flag nach dem Ausführen zurücksetzen!
    return;
  }

  // 2. Zeitberechnung
  const uint32_t elapsedUs = nowUs - lastStateChangeUs;

  // Fall A: Wir sind im BLITZ-Modus und die Anschaltzeit ist abgelaufen -> AUSSCHALTEN
  if (shownOn && (elapsedUs >= onTimeUs))
  {
    FastLED.clear();
    FastLED.show(); // Schaltet die LEDs aus
    shownOn = false;
    lastStateChangeUs = nowUs; // Zeitstempel für die Pause startet jetzt
  }
  // Fall B: Wir sind in der PAUSE und die Pause ist abgelaufen -> EINSCHALTEN
  else if (!shownOn && (elapsedUs >= offTimeUs))
  {
    // Pixel füllen
    for (uint8_t w = 0; w < NUM_WINGS; ++w)
    {
      for (uint8_t i = 0; i < LEDS_PER_WING; i += 3)
      {
        setWingPixel(w, i, CRGB::White);
      }
    }
    FastLED.show(); // Schaltet die LEDs ein
    shownOn = true;
    lastStateChangeUs = nowUs; // Zeitstempel für den Blitz startet jetzt

    // RPM Zeitmessung
    if (lastFlashStartUs != 0)
    {
      gLastStrobePeriodUs = nowUs - lastFlashStartUs;
    }
    lastFlashStartUs = nowUs;
  }

  // Wenn keines von beiden zutrifft, tut diese Funktion absolut NICHTS.
  // Das schont die CPU-Ressourcen extrem.
}

// 1. ENERGIE-WELLE (Schießt von innen nach außen)
void eff_EnergieWelle()
{
  FastLED.clear();
  // Nutze effectSpeed für die Wellen-Frequenz
  uint8_t pos = beatsin8(effectSpeed / 4, 0, LEDS_PER_WING - 1);
  for (uint8_t w = 0; w < NUM_WINGS; w++)
  {
    setWingPixel(w, pos, CHSV(gHue, 255, 255));
    // Kleiner Schweif nach innen/außen
    if (pos > 0)
      setWingPixel(w, pos - 1, CHSV(gHue, 255, 100));
    if (pos < LEDS_PER_WING - 1)
      setWingPixel(w, pos + 1, CHSV(gHue, 255, 100));
  }
}

// 2. REGENBOGEN-SPIRALE (Klassisches rotierendes Farbrad)
void eff_RegenbogenSpirale()
{
  for (uint8_t w = 0; w < NUM_WINGS; w++)
  {
    for (uint8_t i = 0; i < LEDS_PER_WING; i++)
    {
      // Jeder Flügel startet farblich leicht versetzt
      setWingPixel(w, i, CHSV(gHue + (w * 40) + (i * 2), 255, 255));
    }
  }
}

// 3. NORDLICHT / AURORA (Sanftes, träges Fließen)
void eff_Nordlicht()
{
  uint8_t speedFactor = effectSpeed / 8; // Sehr langsame Bewegung
  for (uint8_t w = 0; w < NUM_WINGS; w++)
  {
    for (uint8_t i = 0; i < LEDS_PER_WING; i++)
    {
      // Erzeugt organische Wellen über Sinus-Kombinationen
      uint8_t hueShift = beatsin8(speedFactor, 100, 180, 0, w * 20 + i);
      setWingPixel(w, i, CHSV(hueShift, 230, 200));
    }
  }
}

// 4. FEUER-WIRBEL (Glühender Effekt im Zentrum)
void eff_FeuerWirbel()
{
  // Jede LED verblasst leicht, um Schweif zu erzeugen
  fadeToBlackBy(leds, NUM_LEDS, 40);

  // Zufälliges Aufflackern basierend auf Geschwindigkeit
  if (random8() < effectSpeed)
  {
    uint8_t w = random8(NUM_WINGS);
    uint8_t i = random8(LEDS_PER_WING / 2);                           // Mehr Hitze im Zentrum
    setWingPixel(w, i, CHSV(random8(0, 25), 255, random8(150, 255))); // Rot bis Gelb
  }
}

// 5. RADIALER PULS (Einatmen / Ausatmen)
void eff_RadialerPuls()
{
  // Berechne globale Helligkeitswelle (Sinus)
  uint8_t pulseBrightness = beatsin8(effectSpeed / 2, 20, 255);
  for (uint8_t i = 0; i < NUM_LEDS; i++)
  {
    leds[i] = CHSV(gHue, 255, pulseBrightness);
  }
}

// 6. METEOR-SCHWEIF (Ein Punkt läuft nach außen weg)
void eff_Meteor()
{
  fadeToBlackBy(leds, NUM_LEDS, 30); // Schweif-Länge

  // Punkt wandert linear nach außen
  static float index = 0;
  index += (float)effectSpeed / 100.0;
  if (index >= LEDS_PER_WING)
    index = 0;

  for (uint8_t w = 0; w < NUM_WINGS; w++)
  {
    setWingPixel(w, (uint8_t)index, CHSV(gHue, 200, 255));
  }
}

// 7. FARBMISCHER (Feste Kontrastfarben pro Flügel)
void eff_Farbmischer()
{
  // Bei hoher Drehzahl mischen sich diese Farben an der Decke zu Weiß
  CRGB wingColors[NUM_WINGS] = {CRGB::Red, CRGB::Green, CRGB::Blue, CRGB::Yellow, CRGB::Magenta};
  for (uint8_t w = 0; w < NUM_WINGS; w++)
  {
    for (uint8_t i = 0; i < LEDS_PER_WING; i++)
    {
      setWingPixel(w, i, wingColors[w]);
    }
  }
}

// 8. TACHO-FEEDBACK (Lichtbalken von innen nach außen)
void eff_Tacho()
{
  FastLED.clear();
  // Mappe die Geschwindigkeit (1-255) auf die 30 LEDs des Flügels
  uint8_t maxLed = map(effectSpeed, 1, 255, 0, LEDS_PER_WING);
  for (uint8_t w = 0; w < NUM_WINGS; w++)
  {
    for (uint8_t i = 0; i < maxLed; i++)
    {
      setWingPixel(w, i, CRGB::Cyan);
    }
  }
}

// 9. GEWITTER (Kaltweiße Zufallsblitze)
void eff_Gewitter()
{
  FastLED.clear();
  if (random8() < (effectSpeed / 10))
  { // Blitz-Wahrscheinlichkeit
    uint8_t w = random8(NUM_WINGS);
    for (uint8_t i = 0; i < LEDS_PER_WING; i++)
    {
      setWingPixel(w, i, CRGB::White);
    }
    // Flash visible for one frame (~20 ms); no blocking delay needed.
  }
}

// 10. LAUFLICHT-ZICKZACK (Zickzack durch die Flügel)
void eff_ZickZack()
{
  fadeToBlackBy(leds, NUM_LEDS, 50);
  uint32_t totalMs = static_cast<uint32_t>(static_cast<uint64_t>(millis()) * (effectSpeed / 20 + 1));
  uint8_t activeWing = (totalMs / 200) % NUM_WINGS;
  uint8_t activeLed = (totalMs / 10) % LEDS_PER_WING;

  setWingPixel(activeWing, activeLed, CHSV(gHue, 255, 255));
}

// 11. STATIC RGB (alle LEDs gleiche Mischfarbe)
void eff_StaticRgb()
{
  static bool initialized = false;
  static uint8_t lastRed = 0;
  static uint8_t lastGreen = 0;
  static uint8_t lastBlue = 0;

  if (!gForceEffectDraw && initialized &&
      lastRed == solidRed &&
      lastGreen == solidGreen &&
      lastBlue == solidBlue)
  {
    gEffectRequestsShow = false;
    return;
  }

  const CRGB color(solidRed, solidGreen, solidBlue);
  fill_solid(leds, NUM_LEDS, color);
  lastRed = solidRed;
  lastGreen = solidGreen;
  lastBlue = solidBlue;
  initialized = true;
}

typedef void (*EffectFn)();

struct EffectDef
{
  const char *name;
  EffectFn run;
};

// Generated by Copilot
static const EffectDef kEffects[] = {
    {"Stroboskop", eff_Stroboskop},
    {"Energie-Welle", eff_EnergieWelle},
    {"Regenbogen-Spirale", eff_RegenbogenSpirale},
    {"Nordlicht", eff_Nordlicht},
    {"Feuer-Wirbel", eff_FeuerWirbel},
    {"Radialer Puls", eff_RadialerPuls},
    {"Meteor", eff_Meteor},
    {"Farbmischer", eff_Farbmischer},
    {"Tacho", eff_Tacho},
    {"Gewitter", eff_Gewitter},
    {"ZickZack", eff_ZickZack},
    {"Static RGB", eff_StaticRgb},
};

inline uint8_t ledEffectCount()
{
  return static_cast<uint8_t>(sizeof(kEffects) / sizeof(kEffects[0]));
}

inline const char *ledEffectName(const uint8_t idx)
{
  return idx < ledEffectCount() ? kEffects[idx].name : "Unknown";
}

// ==========================================
// CORE CORE-FUNKTIONEN (INITIALISIERUNG & LOOP)
// ==========================================

void initLEDs()
{
  // Initialisiere FastLED für WS2812
  // FastLED.addLeds<WS2812, LED_PIN, GRB>(leds, NUM_LEDS).setCorrection(TypicalLEDStrip);
  // WS2812B statt WS2812 verwenden, um das sauberere Timing für moderne Strips zu nutzen
  FastLED.addLeds<WS2812B, 4, GRB>(leds, NUM_LEDS).setCorrection(TypicalLEDStrip);
  FastLED.setBrightness(globalBrightness);
  FastLED.clear();
  FastLED.show();
}

void updateLEDs()
{
  const bool effectChanged = currentEffect != gLastRenderedEffect;
  gForceEffectDraw = effectChanged;
  gEffectRequestsShow = true;

  // Globale Helligkeit setzen
  FastLED.setBrightness(globalBrightness);

  // Farb-Frequenz für Regenbögen (unabhängig vom Effekt steuerbar)
  EVERY_N_MILLISECONDS(20)
  {
    gHue++;
  }

  if (currentEffect < ledEffectCount())
  {
    kEffects[currentEffect].run();
  }
  else
  {
    FastLED.clear();
  }

  // Stroboskop regelt sein show() selbst für maximales Timing, alle anderen hier:
  if (currentEffect != 0 && gEffectRequestsShow)
  {
    FastLED.show();
  }

  gLastRenderedEffect = currentEffect;
}

#endif
