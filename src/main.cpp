#include <Arduino.h>
#include <ArduinoOTA.h>
#include <ESP8266HTTPUpdateServer.h>
#include <ESP8266WebServer.h>
#include <ESP8266WiFi.h>
#include <LittleFS.h>
#include "led.h"

#ifndef WIFI_SSID
#error WIFI_SSID is not defined. Fill esp8266-target/.env before building.
#endif

#ifndef WIFI_PASSWORD
#error WIFI_PASSWORD is not defined. Fill esp8266-target/.env before building.
#endif

#ifndef OTA_HOSTNAME
#error OTA_HOSTNAME is not defined. Fill esp8266-target/.env before building.
#endif

#ifndef SERIAL_BAUD
#define SERIAL_BAUD 115200
#endif

#ifndef WIFI_CONNECT_TIMEOUT_MS
#define WIFI_CONNECT_TIMEOUT_MS 15000UL
#endif

#ifndef REMOTE_SIGNAL_BAUD
#define REMOTE_SIGNAL_BAUD 9600
#endif

#ifndef REMOTE_SIGNAL_RX_PIN
#define REMOTE_SIGNAL_RX_PIN 3
#endif

#ifndef FAN_RELAY_1_PIN
#define FAN_RELAY_1_PIN 14
#endif

#ifndef FAN_RELAY_2_PIN
#define FAN_RELAY_2_PIN 12
#endif

#ifndef FAN_RELAY_3_PIN
#define FAN_RELAY_3_PIN 15
#endif

#ifndef OTA_PORT
#define OTA_PORT 8266
#endif

#ifndef FALLBACK_AP_SSID
#define FALLBACK_AP_SSID "ifan04-setup"
#endif

#ifndef FALLBACK_AP_PASSWORD
#define FALLBACK_AP_PASSWORD ""
#endif

namespace
{
  enum class FanSpeed
  {
    Off,
    Low,
    Mid,
    High,
  };

  struct Config
  {
    String wifiSsid;
    String wifiPassword;
    String otaHostname;
    String fallbackApSsid;
    String fallbackApPassword;
  };

  const unsigned long kConnectTimeoutMs = WIFI_CONNECT_TIMEOUT_MS;
  constexpr char kConfigPath[] = "/config.txt";
  constexpr size_t kMaxSignalBufferBytes = 128;
  constexpr size_t kRawUartTailHexChars = 128;
  constexpr unsigned long kSignalFrameGapMs = 40;
  constexpr uint16_t kRemoteHeader = 0xAA55;
  constexpr uint16_t kRemoteHighFan = 0x0104;
  constexpr uint32_t kRemoteLowFanOff = 0x000100;
  constexpr uint32_t kRemoteLowFanLow = 0x000101;
  constexpr uint32_t kRemoteLowFanMid = 0x000102;
  constexpr uint32_t kRemoteLowFanHigh = 0x000103;
  constexpr uint32_t kRemoteLowLightToggle = 0x000104;
  constexpr unsigned long kLightEffectStepMs = 20;
  constexpr float kFanBladeCount = 5.0f;

  Config activeConfig = {
      WIFI_SSID,
      WIFI_PASSWORD,
      OTA_HOSTNAME,
      FALLBACK_AP_SSID,
      FALLBACK_AP_PASSWORD,
  };
  // Generated by Copilot: Web updater as cable-free fallback when espota is blocked.
  ESP8266HTTPUpdateServer httpUpdater;
  ESP8266WebServer webServer(80);
  String signalBuffer;
  unsigned long lastSignalByteAtMs = 0;
  unsigned long scheduledRestartAtMs = 0;
  bool wifiConnected = false;
  bool fallbackApActive = false;
  bool otaReady = false;
  bool relay1State = false;
  bool relay2State = false;
  bool relay3State = false;
  bool lightEffectEnabled = false;
  unsigned long lastLightEffectAtMs = 0;
  FanSpeed currentFanSpeed = FanSpeed::Off;
  String lastRemoteFrame = "none";
  String lastRemoteCommand = "none";
  String rawUartTail = "";
  unsigned long lastRawUartAtMs = 0;
  uint32_t rawUartByteCount = 0;

  String currentIpAddress()
  {
    return fallbackApActive ? WiFi.softAPIP().toString() : WiFi.localIP().toString();
  }

  // Generated by Copilot
  String jsonEscape(const String &value)
  {
    String escaped;
    escaped.reserve(value.length() + 8);

    for (size_t i = 0; i < value.length(); ++i)
    {
      const char c = value[i];
      switch (c)
      {
      case '"':
        escaped += F("\\\"");
        break;
      case '\\':
        escaped += F("\\\\");
        break;
      case '\b':
        escaped += F("\\b");
        break;
      case '\f':
        escaped += F("\\f");
        break;
      case '\n':
        escaped += F("\\n");
        break;
      case '\r':
        escaped += F("\\r");
        break;
      case '\t':
        escaped += F("\\t");
        break;
      default:
        if (static_cast<uint8_t>(c) < 0x20)
        {
          escaped += '?';
        }
        else
        {
          escaped += c;
        }
        break;
      }
    }

    return escaped;
  }

  String fanSpeedLabel(const FanSpeed speed)
  {
    switch (speed)
    {
    case FanSpeed::Low:
      return F("low");
    case FanSpeed::Mid:
      return F("mid");
    case FanSpeed::High:
      return F("high");
    case FanSpeed::Off:
    default:
      return F("off");
    }
  }

  void setFanRelayStates(const bool relay1, const bool relay2, const bool relay3)
  {
    relay1State = relay1;
    relay2State = relay2;
    relay3State = relay3;

    digitalWrite(FAN_RELAY_1_PIN, relay1State ? HIGH : LOW);
    digitalWrite(FAN_RELAY_2_PIN, relay2State ? HIGH : LOW);
    digitalWrite(FAN_RELAY_3_PIN, relay3State ? HIGH : LOW);
  }

  void applyFanSpeed(const FanSpeed speed)
  {
    currentFanSpeed = speed;

    switch (speed)
    {
    case FanSpeed::Low:
      setFanRelayStates(true, false, false);
      break;
    case FanSpeed::Mid:
      setFanRelayStates(true, true, false);
      break;
    case FanSpeed::High:
      setFanRelayStates(false, false, true);
      break;
    case FanSpeed::Off:
    default:
      setFanRelayStates(false, false, false);
      break;
    }
  }

  void clearLightStrip()
  {
    FastLED.clear();
    FastLED.show();
  }

  void setLightEffectEnabled(const bool enabled)
  {
    if (lightEffectEnabled == enabled)
    {
      return;
    }

    lightEffectEnabled = enabled;
    if (!lightEffectEnabled)
    {
      clearLightStrip();
      return;
    }

    lastLightEffectAtMs = 0;
  }

  void updateLightEffect()
  {
    if (!lightEffectEnabled)
    {
      return;
    }

    const unsigned long nowMs = millis();
    // Strobe effect (0) needs microsecond-level call frequency for the 1 ms flash window;
    // skip the step throttle so it runs every loop iteration.
    if (currentEffect != 0 && lastLightEffectAtMs != 0 && nowMs - lastLightEffectAtMs < kLightEffectStepMs)
    {
      return;
    }

    lastLightEffectAtMs = nowMs;
    updateLEDs();
  }

  uint8_t commandChecksum(const uint8_t *frame)
  {
    uint16_t sum = 0;
    for (size_t index = 2; index <= 6; ++index)
    {
      sum += frame[index];
    }
    return static_cast<uint8_t>(sum & 0xFF);
  }

  void appendRawUartByte(const uint8_t value)
  {
    char hexByte[3];
    snprintf_P(hexByte, sizeof(hexByte), PSTR("%02X"), value);
    rawUartTail += hexByte;
    if (rawUartTail.length() > kRawUartTailHexChars)
    {
      rawUartTail.remove(0, rawUartTail.length() - kRawUartTailHexChars);
    }
    rawUartByteCount++;
    lastRawUartAtMs = millis();
  }

  String formatRemoteFrameHex(const uint8_t *frame)
  {
    char frameHex[24];
    snprintf_P(
        frameHex,
        sizeof(frameHex),
        PSTR("%02X%02X%02X%02X%02X%02X%02X%02X"),
        frame[0],
        frame[1],
        frame[2],
        frame[3],
        frame[4],
        frame[5],
        frame[6],
        frame[7]);
    return String(frameHex);
  }

  bool parseRemoteFrame(const uint8_t *frame)
  {
    const uint16_t header = static_cast<uint16_t>(frame[0] << 8) | frame[1];
    if (header != kRemoteHeader)
    {
      return false;
    }

    if (commandChecksum(frame) != frame[7])
    {
      return false;
    }

    const uint16_t commandHigh = static_cast<uint16_t>(frame[2] << 8) | frame[3];
    const uint32_t commandLow = (static_cast<uint32_t>(frame[4]) << 16) |
                                (static_cast<uint32_t>(frame[5]) << 8) |
                                static_cast<uint32_t>(frame[6]);
    lastRemoteFrame = formatRemoteFrameHex(frame);

    if (commandHigh != kRemoteHighFan)
    {
      lastRemoteCommand = F("other");
      return true;
    }

    if (commandLow == kRemoteLowFanOff)
    {
      lastRemoteCommand = F("fan_off");
      applyFanSpeed(FanSpeed::Off);
      return true;
    }

    if (commandLow == kRemoteLowFanLow)
    {
      lastRemoteCommand = F("fan_1");
      applyFanSpeed(FanSpeed::Low);
      return true;
    }

    if (commandLow == kRemoteLowFanMid)
    {
      lastRemoteCommand = F("fan_2");
      applyFanSpeed(FanSpeed::Mid);
      return true;
    }

    if (commandLow == kRemoteLowFanHigh)
    {
      lastRemoteCommand = F("fan_3");
      applyFanSpeed(FanSpeed::High);
      return true;
    }

    if (commandLow == kRemoteLowLightToggle)
    {
      lastRemoteCommand = F("light_toggle");
      setLightEffectEnabled(!lightEffectEnabled);
      return true;
    }

    lastRemoteCommand = F("fan_unknown");
    return true;
  }

  void processRemotePayload(const String &payload)
  {
    if (payload.length() < 8)
    {
      return;
    }

    // Generated by Copilot: Scan payload for complete 8-byte IFAN remote frames.
    for (size_t index = 0; index + 7 < payload.length(); ++index)
    {
      uint8_t frame[8];
      for (size_t offset = 0; offset < 8; ++offset)
      {
        frame[offset] = static_cast<uint8_t>(payload[index + offset]);
      }

      if (parseRemoteFrame(frame))
      {
        index += 7;
      }
    }
  }

  String currentNetworkMode()
  {
    if (wifiConnected)
    {
      return F("wifi");
    }

    if (fallbackApActive)
    {
      return F("ap");
    }

    return F("offline");
  }

  String fallbackApSsidWithChipId()
  {
    String ssid = activeConfig.fallbackApSsid;
    if (ssid.length() == 0)
    {
      ssid = F("ifan04");
    }

    ssid += '-';
    ssid += String(ESP.getChipId(), HEX);
    return ssid;
  }

  void persistConfig()
  {
    File configFile = LittleFS.open(kConfigPath, "w");
    if (!configFile)
    {
      return;
    }

    configFile.printf("WIFI_SSID=%s\n", activeConfig.wifiSsid.c_str());
    configFile.printf("WIFI_PASSWORD=%s\n", activeConfig.wifiPassword.c_str());
    configFile.printf("OTA_HOSTNAME=%s\n", activeConfig.otaHostname.c_str());
    configFile.printf("FALLBACK_AP_SSID=%s\n", activeConfig.fallbackApSsid.c_str());
    configFile.printf("FALLBACK_AP_PASSWORD=%s\n", activeConfig.fallbackApPassword.c_str());
    configFile.close();
  }

  void loadPersistedConfig()
  {
    if (!LittleFS.exists(kConfigPath))
    {
      return;
    }

    File configFile = LittleFS.open(kConfigPath, "r");
    if (!configFile)
    {
      return;
    }

    while (configFile.available())
    {
      String line = configFile.readStringUntil('\n');
      line.trim();
      if (line.length() == 0 || line.startsWith("#"))
      {
        continue;
      }

      const int separator = line.indexOf('=');
      if (separator <= 0)
      {
        continue;
      }

      const String key = line.substring(0, separator);
      const String value = line.substring(separator + 1);

      if (key == F("WIFI_SSID"))
      {
        activeConfig.wifiSsid = value;
      }
      else if (key == F("WIFI_PASSWORD"))
      {
        activeConfig.wifiPassword = value;
      }
      else if (key == F("OTA_HOSTNAME"))
      {
        activeConfig.otaHostname = value;
      }
      else if (key == F("FALLBACK_AP_SSID"))
      {
        activeConfig.fallbackApSsid = value;
      }
      else if (key == F("FALLBACK_AP_PASSWORD"))
      {
        activeConfig.fallbackApPassword = value;
      }
    }

    configFile.close();
  }

  void clearPersistedConfig()
  {
    if (LittleFS.exists(kConfigPath))
    {
      LittleFS.remove(kConfigPath);
    }
  }

  void storeSignalFrame(const String &payload)
  {
    if (payload.length() == 0)
    {
      return;
    }

    processRemotePayload(payload);
  }

  void flushSignalBuffer()
  {
    if (signalBuffer.length() == 0)
    {
      return;
    }

    storeSignalFrame(signalBuffer);
    signalBuffer = "";
  }

  bool connectToWifi()
  {
    WiFi.persistent(false);
    WiFi.mode(WIFI_STA);
    WiFi.hostname(activeConfig.otaHostname);
    WiFi.begin(activeConfig.wifiSsid.c_str(), activeConfig.wifiPassword.c_str());

    const unsigned long startMs = millis();
    while (WiFi.status() != WL_CONNECTED && millis() - startMs < kConnectTimeoutMs)
    {
      delay(500);
    }

    wifiConnected = WiFi.status() == WL_CONNECTED;
    fallbackApActive = false;

    if (!wifiConnected)
    {
      return false;
    }
    return true;
  }

  void startFallbackAp()
  {
    const String fallbackSsid = fallbackApSsidWithChipId();
    const String fallbackPassword = activeConfig.fallbackApPassword;

    WiFi.disconnect();
    WiFi.mode(WIFI_AP);

    const bool started = fallbackPassword.length() >= 8
                             ? WiFi.softAP(fallbackSsid.c_str(), fallbackPassword.c_str())
                             : WiFi.softAP(fallbackSsid.c_str());

    wifiConnected = false;
    fallbackApActive = started;

    if (!started)
    {
      return;
    }
  }

  void setupOta()
  {
    if (WiFi.status() != WL_CONNECTED)
    {
      otaReady = false;
      return;
    }

    if (otaReady)
    {
      return;
    }

    // Generated by Copilot: Keep WiFi fully awake to reduce OTA invite drops.
    WiFi.setSleepMode(WIFI_NONE_SLEEP);
    ArduinoOTA.setPort(OTA_PORT);
    ArduinoOTA.setHostname(activeConfig.otaHostname.c_str());
    ArduinoOTA.onStart([]() {});
    ArduinoOTA.onEnd([]() {});
    ArduinoOTA.onError([](ota_error_t error)
                       { static_cast<void>(error); });
    ArduinoOTA.begin();
    otaReady = true;
  }

  // Generated by Copilot
  void handleRoot()
  {
    String effectRadios;
    effectRadios.reserve(2200);
    for (uint8_t index = 0; index < ledEffectCount(); ++index)
    {
      effectRadios += F("<label class='pill'><input type='radio' name='effect' value='");
      effectRadios += String(index);
      effectRadios += F("' id='effect_");
      effectRadios += String(index);
      effectRadios += F("'><span>");
      effectRadios += String(index);
      effectRadios += F(": ");
      effectRadios += String(ledEffectName(index));
      effectRadios += F("</span></label>");
    }

    String html;
    html.reserve(7600);
    html += F("<!doctype html><html><head><meta charset='utf-8'><meta name='viewport' content='width=device-width,initial-scale=1'>");
    html += F("<title>iFan04</title><style>body{font-family:Verdana,sans-serif;margin:16px;background:#f6f7fb;color:#222}.card{background:#fff;border-radius:10px;padding:14px;box-shadow:0 2px 8px rgba(0,0,0,.08);max-width:860px}h1{margin:0 0 10px}.meta{font-size:13px;color:#444;margin:6px 0}.controls a,.controls button{display:inline-block;margin:0 8px 8px 0;padding:8px 10px;border-radius:6px;background:#2269d2;color:#fff;text-decoration:none;border:0;cursor:pointer}.mono{font-family:monospace}.tail{font-family:monospace;word-break:break-all;background:#eee;padding:8px;border-radius:5px;font-size:11px}.row{display:flex;gap:10px;flex-wrap:wrap}.field{margin:8px 0}.field label{display:block;font-size:12px;margin-bottom:3px}input[type='number']{padding:6px;min-width:200px}.effect-grid{display:flex;flex-wrap:wrap;gap:8px}.pill{display:inline-flex;align-items:center}.pill input{display:none}.pill span{padding:7px 10px;border-radius:999px;background:#e8eefc;border:1px solid #bfd0f5;cursor:pointer;font-size:12px}.pill input:checked + span{background:#2269d2;color:#fff;border-color:#2269d2}</style>");
    html += F("<script>let applyTimer=null;function isFormBusy(){const a=document.activeElement;return !!(a&&(a.name==='effect'||a.id==='speed'||a.id==='brightness'||a.id==='strobePauseMs'||a.id==='lightEnabled'||a.id==='rgbR'||a.id==='rgbG'||a.id==='rgbB'));}");
    html += F("function buildEffectQuery(){const checked=document.querySelector(\"input[name='effect']:checked\");const effect=checked?checked.value:'0';return '?effect='+encodeURIComponent(effect)+'&speed='+encodeURIComponent(document.getElementById('speed').value)+'&brightness='+encodeURIComponent(document.getElementById('brightness').value)+'&strobePauseMs='+encodeURIComponent(document.getElementById('strobePauseMs').value)+'&rgbR='+encodeURIComponent(document.getElementById('rgbR').value)+'&rgbG='+encodeURIComponent(document.getElementById('rgbG').value)+'&rgbB='+encodeURIComponent(document.getElementById('rgbB').value)+'&enabled='+(document.getElementById('lightEnabled').checked?'1':'0');}");
    html += F("async function applyEffectsInstant(){const q=buildEffectQuery()+'&ajax=1';await fetch('/effect'+q,{cache:'no-store'});}function scheduleApply(){if(applyTimer){clearTimeout(applyTimer);}applyTimer=setTimeout(()=>{applyEffectsInstant();},140);}function bindInstantControls(){document.querySelectorAll(\"input[name='effect']\").forEach((el)=>el.addEventListener('change',scheduleApply));['speed','brightness','strobePauseMs','rgbR','rgbG','rgbB'].forEach((id)=>{const el=document.getElementById(id);el.addEventListener('input',scheduleApply);el.addEventListener('change',scheduleApply);});document.getElementById('lightEnabled').addEventListener('change',scheduleApply);} ");
    html += F("async function refresh(){const d=await (await fetch('/api/status')).json();document.getElementById('s').textContent='mode='+d.mode+' ip='+d.ip+' ssid='+d.connectedSsid+' ota='+d.otaHostname+' fan='+d.fanSpeed+' light='+(d.lightEffect?'on':'off')+' effect='+d.effectName+' speed='+d.effectSpeed+' bright='+d.lightBrightness+' rgb='+d.rgbR+','+d.rgbG+','+d.rgbB+' strobe='+Number(d.strobeHz).toFixed(2)+'Hz rpm~'+Number(d.strobeRpm).toFixed(1);document.getElementById('lightState').textContent=d.lightEffect?'ON':'OFF';document.getElementById('effectLabel').textContent=d.effectName;document.getElementById('rfFrame').textContent=d.lastRemoteFrame;document.getElementById('rfCmd').textContent=d.lastRemoteCommand;document.getElementById('uartTail').textContent=d.rawUartTail;if(!isFormBusy()){const selected=document.querySelector(\"input[name='effect'][value='\"+String(d.effectIndex)+\"']\");if(selected){selected.checked=true;}document.getElementById('speed').value=d.effectSpeed;document.getElementById('brightness').value=d.lightBrightness;document.getElementById('strobePauseMs').value=d.strobePauseMs;document.getElementById('rgbR').value=d.rgbR;document.getElementById('rgbG').value=d.rgbG;document.getElementById('rgbB').value=d.rgbB;document.getElementById('lightEnabled').checked=!!d.lightEffect;}}");
    html += F("function applyEffects(){applyEffectsInstant();return false;}setInterval(refresh,1500);window.addEventListener('load',()=>{bindInstantControls();refresh();});</script></head><body>");
    html += F("<section class='card'><h1>Sonoff iFan04</h1><div id='s' class='meta'>loading...</div><div class='controls'><a href='/fan?speed=off'>OFF</a><a href='/fan?speed=low'>1</a><a href='/fan?speed=mid'>2</a><a href='/fan?speed=high'>3</a><a href='/light?state=toggle'>LIGHT TOGGLE</a></div>");
    html += F("<p><strong>Licht:</strong> <span id='lightState' class='mono'>OFF</span> | <strong>Effekt:</strong> <span id='effectLabel' class='mono'>-</span></p>");
    html += F("<form onsubmit='return applyEffects();'><div class='row'><div class='field'><label>Effekt</label><div class='effect-grid'>");
    html += effectRadios;
    html += F("</div></div><div class='field'><label for='speed'>Speed (1-255)</label><input id='speed' type='number' min='1' max='255' value='128'></div><div class='field'><label for='brightness'>Brightness (0-255)</label><input id='brightness' type='number' min='0' max='255' value='150'></div><div class='field'><label for='strobePauseMs'>Strobe Pause ms</label><input id='strobePauseMs' type='number' min='5' max='1000' value='80'></div><div class='field'><label for='rgbR'>RGB Rot (0-255)</label><input id='rgbR' type='number' min='0' max='255' value='255'></div><div class='field'><label for='rgbG'>RGB Gruen (0-255)</label><input id='rgbG' type='number' min='0' max='255' value='255'></div><div class='field'><label for='rgbB'>RGB Blau (0-255)</label><input id='rgbB' type='number' min='0' max='255' value='255'></div><div class='field'><label for='lightEnabled'>Licht aktiv</label><input id='lightEnabled' type='checkbox'></div></div><div class='controls'><button type='submit'>Jetzt senden (optional)</button></div></form>");
    html += F("<h3>RF-Fernbedienung Debug</h3><p><strong>Letzter Frame:</strong> <span id='rfFrame' class='mono'>none</span></p><p><strong>Letzter Befehl:</strong> <span id='rfCmd'>none</span></p><p><strong>Roher UART-Puffer (Hex):</strong></p><div id='uartTail' class='tail'>none</div></section></body></html>");

    webServer.send(200, F("text/html; charset=utf-8"), html);
  }

  void handleStatusApi()
  {
    const String apName = fallbackApSsidWithChipId();
    const unsigned long uartAgeMs = lastRawUartAtMs == 0 ? 0 : millis() - lastRawUartAtMs;
    const float strobeHz = gLastStrobePeriodUs > 0 ? (1000000.0f / static_cast<float>(gLastStrobePeriodUs)) : 0.0f;
    const float strobeRpm = strobeHz > 0.0f ? (strobeHz * 60.0f / kFanBladeCount) : 0.0f;
    String json;
    json.reserve(760);
    json += F("{\"mode\":\"");
    json += jsonEscape(currentNetworkMode());
    json += F("\",\"ip\":\"");
    json += jsonEscape(currentIpAddress());
    json += F("\",\"connectedSsid\":\"");
    json += jsonEscape(wifiConnected ? activeConfig.wifiSsid : apName);
    json += F("\",\"otaHostname\":\"");
    json += jsonEscape(activeConfig.otaHostname);
    json += F("\",\"fanSpeed\":\"");
    json += jsonEscape(fanSpeedLabel(currentFanSpeed));
    json += F("\",\"lightEffect\":");
    json += lightEffectEnabled ? F("true") : F("false");
    json += F(",\"effectIndex\":");
    json += String(currentEffect);
    json += F(",\"effectName\":\"");
    json += jsonEscape(String(ledEffectName(currentEffect)));
    json += F("\",\"effectSpeed\":");
    json += String(effectSpeed);
    json += F(",\"lightBrightness\":");
    json += String(globalBrightness);
    json += F(",\"strobePauseMs\":");
    json += String(strobePauseMs);
    json += F(",\"strobeHz\":");
    json += String(strobeHz, 2);
    json += F(",\"strobeRpm\":");
    json += String(strobeRpm, 1);
    json += F(",\"rgbR\":");
    json += String(solidRed);
    json += F(",\"rgbG\":");
    json += String(solidGreen);
    json += F(",\"rgbB\":");
    json += String(solidBlue);
    json += F(",\"relay1\":");
    json += relay1State ? F("true") : F("false");
    json += F(",\"relay2\":");
    json += relay2State ? F("true") : F("false");
    json += F(",\"relay3\":");
    json += relay3State ? F("true") : F("false");
    json += F(",\"uartBytes\":");
    json += String(static_cast<unsigned long>(rawUartByteCount));
    json += F(",\"uartAgeMs\":");
    json += String(uartAgeMs);
    json += F(",\"lastRemoteFrame\":\"");
    json += jsonEscape(lastRemoteFrame);
    json += F("\",\"lastRemoteCommand\":\"");
    json += jsonEscape(lastRemoteCommand);
    json += F("\",\"rawUartTail\":\"");
    json += jsonEscape(rawUartTail);
    json += F("\"}");
    webServer.send(200, F("application/json"), json);
  }

  void handleSetFanSpeed()
  {
    const String speed = webServer.arg("speed");

    if (speed == F("off"))
    {
      applyFanSpeed(FanSpeed::Off);
    }
    else if (speed == F("low"))
    {
      applyFanSpeed(FanSpeed::Low);
    }
    else if (speed == F("mid"))
    {
      applyFanSpeed(FanSpeed::Mid);
    }
    else if (speed == F("high"))
    {
      applyFanSpeed(FanSpeed::High);
    }
    else
    {
      webServer.send(400, F("text/plain"), F("invalid speed"));
      return;
    }

    webServer.sendHeader(F("Location"), F("/"));
    webServer.send(303, F("text/plain"), F("ok"));
  }

  // Generated by Copilot
  void handleSetLight()
  {
    const String state = webServer.arg("state");

    if (state == F("on"))
    {
      setLightEffectEnabled(true);
    }
    else if (state == F("off"))
    {
      setLightEffectEnabled(false);
    }
    else
    {
      setLightEffectEnabled(!lightEffectEnabled);
    }

    webServer.sendHeader(F("Location"), F("/"));
    webServer.send(303, F("text/plain"), F("ok"));
  }

  // Generated by Copilot
  void handleSetEffect()
  {
    if (webServer.hasArg("effect"))
    {
      const int parsedEffect = webServer.arg("effect").toInt();
      const int maxEffectIndex = ledEffectCount() > 0 ? static_cast<int>(ledEffectCount()) - 1 : 0;
      currentEffect = static_cast<uint8_t>(constrain(parsedEffect, 0, maxEffectIndex));
      setLightEffectEnabled(true);
    }

    if (webServer.hasArg("speed"))
    {
      const int parsedSpeed = webServer.arg("speed").toInt();
      effectSpeed = static_cast<uint8_t>(constrain(parsedSpeed, 1, 255));
    }

    if (webServer.hasArg("brightness"))
    {
      const int parsedBrightness = webServer.arg("brightness").toInt();
      globalBrightness = static_cast<uint8_t>(constrain(parsedBrightness, 0, 255));
    }

    if (webServer.hasArg("strobePauseMs"))
    {
      strobePauseMs = constrain(webServer.arg("strobePauseMs").toInt(), 5, 1000);
    }

    if (webServer.hasArg("rgbR"))
    {
      solidRed = static_cast<uint8_t>(constrain(webServer.arg("rgbR").toInt(), 0, 255));
    }

    if (webServer.hasArg("rgbG"))
    {
      solidGreen = static_cast<uint8_t>(constrain(webServer.arg("rgbG").toInt(), 0, 255));
    }

    if (webServer.hasArg("rgbB"))
    {
      solidBlue = static_cast<uint8_t>(constrain(webServer.arg("rgbB").toInt(), 0, 255));
    }

    if (webServer.hasArg("enabled"))
    {
      const String enabledArg = webServer.arg("enabled");
      setLightEffectEnabled(enabledArg == F("1") || enabledArg == F("true") || enabledArg == F("on"));
    }

    if (webServer.hasArg("ajax") && webServer.arg("ajax") == F("1"))
    {
      webServer.send(200, F("application/json"), F("{\"ok\":true}"));
      return;
    }

    webServer.sendHeader(F("Location"), F("/"));
    webServer.send(303, F("text/plain"), F("ok"));
  }

  void handleSaveConfig()
  {
    const String wifiSsid = webServer.arg("wifiSsid");
    const String otaHostname = webServer.arg("otaHostname");
    const String fallbackApPassword = webServer.arg("fallbackApPassword");

    if (wifiSsid.length() == 0 || otaHostname.length() == 0)
    {
      webServer.send(400, F("text/plain"), F("wifiSsid and otaHostname are required"));
      return;
    }

    if (fallbackApPassword.length() > 0 && fallbackApPassword.length() < 8)
    {
      webServer.send(400, F("text/plain"), F("fallbackApPassword must be empty or at least 8 characters"));
      return;
    }

    activeConfig.wifiSsid = wifiSsid;
    activeConfig.wifiPassword = webServer.arg("wifiPassword");
    activeConfig.otaHostname = otaHostname;
    activeConfig.fallbackApSsid = webServer.arg("fallbackApSsid");
    activeConfig.fallbackApPassword = fallbackApPassword;

    persistConfig();
    scheduledRestartAtMs = millis() + 1500;
    webServer.send(200, F("text/html; charset=utf-8"), F("<html><body><h1>Saved</h1><p>Configuration stored in flash. The device will restart now.</p></body></html>"));
  }

  void handleClearConfig()
  {
    clearPersistedConfig();
    scheduledRestartAtMs = millis() + 1500;
    webServer.send(200, F("text/html; charset=utf-8"), F("<html><body><h1>Cleared</h1><p>Stored configuration removed. The device will restart and use .env defaults again.</p></body></html>"));
  }

  void setupWebServer()
  {
    httpUpdater.setup(&webServer, F("/update"));
    webServer.on(F("/"), HTTP_GET, handleRoot);
    webServer.on(F("/api/status"), HTTP_GET, handleStatusApi);
    webServer.on(F("/fan"), HTTP_GET, handleSetFanSpeed);
    webServer.on(F("/light"), HTTP_GET, handleSetLight);
    webServer.on(F("/effect"), HTTP_GET, handleSetEffect);
    webServer.on(F("/config"), HTTP_POST, handleSaveConfig);
    webServer.on(F("/clear-config"), HTTP_POST, handleClearConfig);
    webServer.begin();
  }
} // namespace

void setup()
{
  initLEDs();
  setLightEffectEnabled(false);

  pinMode(FAN_RELAY_1_PIN, OUTPUT);
  pinMode(FAN_RELAY_2_PIN, OUTPUT);
  pinMode(FAN_RELAY_3_PIN, OUTPUT);
  applyFanSpeed(FanSpeed::Off);

  Serial.begin(REMOTE_SIGNAL_BAUD);

  if (!LittleFS.begin())
  {
    LittleFS.format();
    LittleFS.begin();
  }

  loadPersistedConfig();

  if (!connectToWifi())
  {
    startFallbackAp();
  }

  setupOta();
  setupWebServer();
}

void loop()
{
  while (Serial.available())
  {
    const char current = static_cast<char>(Serial.read());
    appendRawUartByte(static_cast<uint8_t>(current));
    signalBuffer += current;
    if (signalBuffer.length() >= kMaxSignalBufferBytes || current == '\n' || current == '\r')
    {
      flushSignalBuffer();
    }
    lastSignalByteAtMs = millis();
  }

  if (signalBuffer.length() > 0 && millis() - lastSignalByteAtMs > kSignalFrameGapMs)
  {
    flushSignalBuffer();
  }

  setupOta();
  if (otaReady)
  {
    ArduinoOTA.handle();
  }

  webServer.handleClient();
  updateLightEffect();

  if (scheduledRestartAtMs != 0 && millis() >= scheduledRestartAtMs)
  {
    ESP.restart();
  }
}
